## isa/alpha64/platform/linux/defconfig
```kconfig
#
# ISAComp Alpha64 Linux Kernel Configuration
# Minimal configuration for initial boot on ISAComp-generated processor
#

# Architecture
CONFIG_ALPHA=y
CONFIG_64BIT=y
CONFIG_MMU=y

# Platform - ISAComp
# CONFIG_ALPHA_GENERIC is not set
CONFIG_ALPHA_ISACOMP=y
# CONFIG_ALPHA_ALCOR is not set
# CONFIG_ALPHA_XL is not set
# CONFIG_ALPHA_BOOK1 is not set
# CONFIG_ALPHA_AVANTI is not set
# CONFIG_ALPHA_CABRIOLET is not set
# CONFIG_ALPHA_DP264 is not set
# CONFIG_ALPHA_EB164 is not set
# CONFIG_ALPHA_EB64P is not set
# CONFIG_ALPHA_EB66 is not set
# CONFIG_ALPHA_EB66P is not set
# CONFIG_ALPHA_EIGER is not set
# CONFIG_ALPHA_JENSEN is not set
# CONFIG_ALPHA_LX164 is not set
# CONFIG_ALPHA_LYNX is not set
# CONFIG_ALPHA_MARVEL is not set
# CONFIG_ALPHA_MIATA is not set
# CONFIG_ALPHA_MIKASA is not set
# CONFIG_ALPHA_NAUTILUS is not set
# CONFIG_ALPHA_NONAME is not set
# CONFIG_ALPHA_NORITAKE is not set
# CONFIG_ALPHA_PC164 is not set
# CONFIG_ALPHA_PRIMO is not set
# CONFIG_ALPHA_RAWHIDE is not set
# CONFIG_ALPHA_RUFFIAN is not set
# CONFIG_ALPHA_RX164 is not set
# CONFIG_ALPHA_SX164 is not set
# CONFIG_ALPHA_SABLE is not set
# CONFIG_ALPHA_SHARK is not set
# CONFIG_ALPHA_TAKARA is not set
# CONFIG_ALPHA_TITAN is not set
# CONFIG_ALPHA_WILDFIRE is not set

# Processor
CONFIG_ALPHA_EV56=y
# CONFIG_ALPHA_EV67 is not set
# CONFIG_SMP is not set
CONFIG_NR_CPUS=1

# No PCI (critical - ISAComp has no PCI bus)
# CONFIG_PCI is not set
# CONFIG_PCI_DOMAINS is not set

# Memory
CONFIG_PAGE_OFFSET=0xFFFFFC0000000000
# CONFIG_DISCONTIGMEM is not set
CONFIG_FLATMEM=y

# Console
CONFIG_SERIAL_8250=y
CONFIG_SERIAL_8250_CONSOLE=y
CONFIG_SERIAL_8250_NR_UARTS=1
CONFIG_SERIAL_8250_RUNTIME_UARTS=1
# CONFIG_SERIAL_8250_PCI is not set
CONFIG_CONSOLE_TRANSLATIONS=y

# Initial ramdisk - built-in initramfs with /init (uncompressed)
CONFIG_BLK_DEV_INITRD=y
CONFIG_INITRAMFS_SOURCE="../isa/alpha64/platform/initramfs/initramfs_list"
CONFIG_INITRAMFS_COMPRESSION_NONE=y
# CONFIG_INITRAMFS_COMPRESSION_GZIP is not set
CONFIG_BLK_DEV_RAM=y

# File systems (minimal)
CONFIG_TMPFS=y
CONFIG_PROC_FS=y
CONFIG_SYSFS=y
CONFIG_DEVTMPFS=y
CONFIG_DEVTMPFS_MOUNT=y
# CONFIG_EXT2_FS is not set
# CONFIG_EXT3_FS is not set
# CONFIG_EXT4_FS is not set

# Networking (disabled for initial boot)
# CONFIG_NET is not set

# Debugging
CONFIG_PRINTK=y
CONFIG_BUG=y
CONFIG_DEBUG_KERNEL=y
CONFIG_DEBUG_INFO=y
CONFIG_EARLY_PRINTK=y
# CONFIG_DEBUG_SLAB is not set
# CONFIG_DEBUG_SPINLOCK is not set
CONFIG_PANIC_TIMEOUT=0

# Disable unnecessary features
# CONFIG_MODULES is not set
# CONFIG_HOTPLUG is not set
# CONFIG_SWAP is not set
# CONFIG_INPUT is not set
# CONFIG_VT is not set
# CONFIG_HW_RANDOM is not set
# CONFIG_HWMON is not set
# CONFIG_USB_SUPPORT is not set
# CONFIG_SOUND is not set
# CONFIG_SCSI is not set
# CONFIG_ATA is not set
# CONFIG_MD is not set
# CONFIG_CRYPTO is not set
```

## isa/hppa/platform64/isacomp_defconfig
```kconfig
CONFIG_SYSVIPC=y
CONFIG_NO_HZ_IDLE=y
CONFIG_HIGH_RES_TIMERS=y
CONFIG_BLK_DEV_INITRD=y
CONFIG_INITRAMFS_SOURCE="../../initramfs/initramfs.cpio"
CONFIG_INITRAMFS_COMPRESSION_NONE=y
CONFIG_CC_OPTIMIZE_FOR_SIZE=y
CONFIG_DEVTMPFS=y
CONFIG_DEVTMPFS_MOUNT=y
# CONFIG_INPUT_KEYBOARD is not set
# CONFIG_INPUT_MOUSE is not set
CONFIG_SERIAL_8250=y
CONFIG_SERIAL_8250_CONSOLE=y
# CONFIG_HW_RANDOM is not set
# CONFIG_HWMON is not set
# CONFIG_HID_SUPPORT is not set
# CONFIG_USB_SUPPORT is not set
# CONFIG_IOMMU_SUPPORT is not set
CONFIG_TMPFS=y
CONFIG_PRINTK_TIME=y
# CONFIG_RUNTIME_TESTING_MENU is not set
```

## isa/riscv64/platform/isacomp_defconfig
```kconfig
# Minimal kernel config for ISAComp RV64 MMU platform
# Single-core, no networking, no PCI, no block devices
# Goal: fast boot to initramfs userspace

# Basic system
CONFIG_SYSVIPC=y
CONFIG_NO_HZ_IDLE=y
CONFIG_HIGH_RES_TIMERS=y
CONFIG_BLK_DEV_INITRD=y
# Set INITRAMFS_SOURCE to point to isa/riscv64/platform/initramfs/initramfs_list in your checkout
# CONFIG_INITRAMFS_SOURCE must be set as an absolute path when building the kernel
CONFIG_INITRAMFS_COMPRESSION_NONE=y
CONFIG_CC_OPTIMIZE_FOR_SIZE=y

# Disable SMP - single core
# CONFIG_SMP is not set

# Disable modules
# CONFIG_MODULES is not set

# Platform support - minimal
CONFIG_ARCH_VIRT=y
CONFIG_NONPORTABLE=y

# Console / serial
CONFIG_SERIAL_8250=y
CONFIG_SERIAL_8250_CONSOLE=y
CONFIG_SERIAL_OF_PLATFORM=y
CONFIG_SERIAL_EARLYCON_RISCV_SBI=y

# Filesystem support (minimal for initramfs)
CONFIG_DEVTMPFS=y
CONFIG_DEVTMPFS_MOUNT=y
CONFIG_PROC_FS=y
CONFIG_SYSFS=y
CONFIG_TMPFS=y

# Disable heavy subsystems
# CONFIG_NET is not set
# CONFIG_PCI is not set
# CONFIG_MTD is not set
# CONFIG_DRM is not set
# CONFIG_SOUND is not set
# CONFIG_USB_SUPPORT is not set
# CONFIG_MEDIA_SUPPORT is not set
# CONFIG_INPUT_MOUSEDEV is not set
# CONFIG_INPUT_KEYBOARD is not set
# CONFIG_INPUT_MOUSE is not set
# CONFIG_VIRTUALIZATION is not set
# CONFIG_ATA is not set
# CONFIG_MD is not set
# CONFIG_BLK_DEV_LOOP is not set
# CONFIG_SCSI is not set
# CONFIG_I2C is not set
# CONFIG_SPI is not set
# CONFIG_HWMON is not set
# CONFIG_THERMAL is not set
# CONFIG_WATCHDOG is not set
# CONFIG_REGULATOR is not set
# CONFIG_POWER_SUPPLY is not set
# CONFIG_MMC is not set
# CONFIG_RTC_CLASS is not set
# CONFIG_DMADEVICES is not set
# CONFIG_IOMMU_SUPPORT is not set
# CONFIG_IIO is not set
# CONFIG_HID_SUPPORT is not set
# CONFIG_SECURITY is not set
# CONFIG_AUDIT is not set
# CONFIG_CRYPTO_MANAGER_DISABLE_TESTS is not set
# CONFIG_DEBUG_FS is not set
# CONFIG_FTRACE is not set
# CONFIG_RUNTIME_TESTING_MENU is not set
# CONFIG_BPF_SYSCALL is not set
# CONFIG_PROFILING is not set
# CONFIG_FB is not set
# CONFIG_VT is not set
# CONFIG_CGROUPS is not set
# CONFIG_NAMESPACES is not set
# CONFIG_CPU_FREQ is not set
# CONFIG_SPARSEMEM_MANUAL is not set
# CONFIG_DEBUG_PAGEALLOC is not set
# CONFIG_DEBUG_VM is not set
# CONFIG_DEBUG_SPINLOCK is not set
# CONFIG_DEBUG_MUTEXES is not set
# CONFIG_DEBUG_ATOMIC_SLEEP is not set
# CONFIG_SOFTLOCKUP_DETECTOR is not set
# CONFIG_SCHED_DEBUG is not set
# CONFIG_DEBUG_INFO is not set

# Printk with timestamps
CONFIG_PRINTK_TIME=y
```
